## CMakeLists.txt
```
# SPDX-License-Identifier: Apache-2.0

cmake_minimum_required(VERSION 3.20.0)
#set(NRF9160_FEATHER_ROOT_DIR ${CMAKE_CURRENT_SOURCE_DIR} CACHE PATH "nRF9160 Feather root directory")
#set(ZEPHYR_EXTRA_MODULES drivers)
#add_subdirectory(drivers)
find_package(Zephyr REQUIRED HINTS $ENV{ZEPHYR_BASE})
#add_subdirectory_ifdef(CONFIG_TOGGLEDRIVER drivers)
project(app LANGUAGES C)
target_sources(app PRIVATE src/main.c)
```

## prj.conf
```kconfig
#CONFIG_GPIO=y
#CONFIG_TOGGLEDRIVER=y
```

## boards/Toggle.overlay
```dts
/ {		
	drivertoggle:ledtoggle{
		compatible  	= 		"toggle";
		status			=		"okay";
		switch-gpios   	=       <&gpiob 3 GPIO_ACTIVE_HIGH>;
	};
	
};

//Our device node "toggle" matches the name in toggle.yaml and toggledriver.c file
//switch-gpios is phandle passed portb gpio3 and initial status as high.
//Note: Gpio pin3 is default connected with led on STM32 nucleo-l432kc board.
```

## src/main.c
```c
/*
Author: Usman Ali Butt usa_butt@hotmail.com
Dated : 6-october-2022
*/
#include <zephyr/kernel.h>
#include <zephyr/device.h>
#include <zephyr/drivers/gpio.h>
#include <toggledriver.h>

/*
Get device from node label. See toggle.overlay file. Compiled
files contains full device tree.
*/
static const struct device *dev = DEVICE_DT_GET(DT_NODELABEL(drivertoggle));

void main(void){	
	
	if (!device_is_ready(dev)) {		//Check if device is created and ready
		printk("Driver not ready");
		return;
	}
	
	//Print device name and object instance address
	printk("Device is %p, name is %s\n", dev, dev->name);
		
	while(1){
		alter(500);						//Alter led after every 0.5 seconds 
	}
	
}
```
